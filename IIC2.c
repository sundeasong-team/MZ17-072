#include "lpc17xx.h"
#include "IIC2.h"
//=============================================================================
#define  READ    1
#define  WRITE   1
//=============================================================================
//SDA2=P0.21
//SCL2=P0.22

#define U8  unsigned char 
#define U16 unsigned short
#define U32 unsigned int

/******************************************************************************
函数：I2C2_Delay()
功能：模拟I2C总线延时
说明：请根据具体情况调整延时值
******************************************************************************/
void I2C2_Delay(){
	unsigned int t;
	t = 10;//
	while ( --t != 0 );		//延时2*t个机器周期
}
//=============================================================================
U8 SDA2()
{	
   	LPC_GPIO0->FIODIR=(LPC_GPIO0->FIODIR) & (~(1<<21));
		return ((LPC_GPIO0->FIOPIN >>21)& 0x01);
}
/******************************************************************************
函数：I2C2_Init()
功能：I2C总线初始化，使总线处于空闲状态
说明：在main()函数的开始处，应当执行一次本函数
******************************************************************************/
void I2C2_Init(){
  LPC_GPIO0->FIODIR=(LPC_GPIO0->FIODIR) | ((1<<21)|(1<<22));
	SCL2_H;
	I2C2_Delay();
	SDA2_H;
	I2C2_Delay();
}


/******************************************************************************
函数：I2C2_Start()
功能：产生I2C总线的起始条件
说明：
	SCL处于高电平期间，当SDA出现下降沿时启动I2C总线
	本函数也用来产生重复起始条件
******************************************************************************/
void I2C2_Start(){
	SDA2_H;
	I2C2_Delay();
	SCL2_H;
	I2C2_Delay();
	SDA2_L;
	I2C2_Delay();
	SCL2_L;
	I2C2_Delay();
}
/******************************************************************************
函数：I2C2_Write()
功能：向I2C总线写1个字节的数据
参数：dat是要写到总线上的数据
******************************************************************************/
void I2C2_Write(unsigned char dat){
 	unsigned char t = 8;
	do{
		if(dat&0x80)SDA2_H
		else SDA2_L
		dat <<= 1;
		SCL2_H;
		I2C2_Delay();
		SCL2_L;
		I2C2_Delay();
	} while ( --t != 0 );

}
/******************************************************************************
函数：I2C2_GetAck()
功能：读取从机应答位（应答或非应答），用于判断：从机是否成功接收主机数据
返回：
	0：从机应答
	1：从机非应答
说明：从机在收到每一个字节后都要产生应答位，主机如果收到非应答则应当终止传输
******************************************************************************/
U8 I2C2_GetAck(){
	U8 ack;
	SDA2_H;
	I2C2_Delay();
	SCL2_H;
	I2C2_Delay();
	ack = SDA2();
	SCL2_L;
	I2C2_Delay();
	return ack;
}
/******************************************************************************
函数：I2C2_Stop()
功能：产生I2C总线的停止条件
说明：SCL处于高电平期间，当SDA出现上升沿时停止I2C总线
******************************************************************************/
void I2C2_Stop(){
	unsigned int t;
	SDA2_L;
	I2C2_Delay();
	SCL2_H;
	I2C2_Delay();
	SDA2_H;
	I2C2_Delay();
  //对于某些器件来说，在下一次产生Start之前，额外增加一定的延时是必须的
	t = 15;
	while ( --t != 0 );
}

/******************************************************************************
函数：I2C2_Puts()
功能：主机通过I2C总线向从机发送1个字节的数据
参数：
	SlaveAddr：从机地址（高7位是从机地址，最低位是读写标志）
	SubAddr：从机的子地址
	size：数据大小（以字节计）
	dat：要发送的数据
返回：
	0：发送成功
	1：在发送过程中出现异常
******************************************************************************/
U8 I2C2_Puts(unsigned char dat){
	I2C2_Write(dat);
	if ( I2C2_GetAck() ){
		I2C2_Stop();
		return 1;
	}
	return 0;
}
/******************************************************************************
函数：I2C2_PutAck()
功能：主机产生应答位（应答或非应答），用于通知从机：主机是否成功接收从机数据
参数：
	ack=0：主机非应答
	ack=1：主机应答
说明：主机在收到每一个字节后都要产生应答，在收到最后一个字节后，应当产生非应答
******************************************************************************/
void I2C2_PutAck(U8 ack){
  if(ack)SDA2_H
	else SDA2_L
	I2C2_Delay();
	SCL2_H;
	I2C2_Delay();
	SCL2_L;
	I2C2_Delay();
}
/******************************************************************************
函数：I2C2_Read()
功能：从从机读取1个字节的数据
返回：读取的1个字节数据
******************************************************************************/
unsigned char I2C2_Read(){
	unsigned char dat;
	unsigned char t = 8;
	SDA2_H;	//在读取数据之前，要把SDA拉高，使之处于输入状态
	do{
		SCL2_H;
		I2C2_Delay();
		dat <<= 1;
		if( SDA2() ) dat++;
		SCL2_L;
		I2C2_Delay();
	} while ( --t != 0 );
	return dat;
}
